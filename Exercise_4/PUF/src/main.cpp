/**
 * Board Serial Number: 85431303636351F02151
 */

#include <Arduino.h>

#define BUF_LEN 256

uint8_t finger_print[] = {0xfb, 0x11, 0xbd, 0xc0, 0xef, 0xfb, 0x7c, 0xf7, 0xf0, 0x1f, 0x9e, 0xfe, 0xfe,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 0x94,
                          0xee, 0x3e, 0xec, 0xdc, 0x46, 0xf1, 0x4a, 0xbd, 0xec, 0xbe, 0x5f, 0xb5,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 0x92,
                          0x15, 0xff, 0xb9, 0xaa, 0xab, 0xfa, 0xf1, 0xfb, 0xef, 0x67, 0xfc, 0x6f,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 0x5d,
                          0xfc, 0xde, 0xef, 0x78, 0x6f, 0xef, 0xb4, 0xff, 0xdf, 0xb9, 0x75, 0xed,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 0x16, 0x0c};

unsigned int count_ones(uint8_t byte_in)
{
  unsigned int ret = 0;
  for (int i = 0; i < 8; i++)
  {
    ret += (byte_in >> i) & 1;
  }
  return ret;
}

int check_device_id(uint8_t *stored_image, uint8_t *read_image)
{
  unsigned int count = 0;
  for (int i = 0; i < BUF_LEN; i++)
  {
    count += count_ones(stored_image[i] ^ read_image[i]);
  }
  Serial.print("Ones = ");
  Serial.println(count);
  if (count <= 164)
  {
    return 0;
  }
  else
  {
    return -1;
  }
}

void setup()
{
  uint8_t buff[256];
  unsigned long sum = 0;
  Serial.begin(115200);
  for (size_t i = 0; i < sizeof(buff); i++)
  {
    sum += (unsigned long)(buff[i]);
    char fmt[6];
    sprintf(fmt, "0x%02x, ", buff[i]);
    Serial.print(fmt);
  }
  Serial.println();
  Serial.print("Sum: ");
  Serial.println(sum);
  int check = check_device_id(finger_print, buff);
  if (check == 0)
  {
    Serial.println("Check OK");
  }
  else
  {
    Serial.println("Check FAILED");
  }
}

void loop()
{
  // put your main code here, to run repeatedly:
}